## configs/deliboz/nsh/defconfig
```kconfig
CONFIG_EXPERIMENTAL=y
CONFIG_HOST_LINUX=y
CONFIG_APPS_DIR="../apps"
CONFIG_BUILD_FLAT=y
CONFIG_INTELHEX_BINARY=y
CONFIG_RAW_BINARY=y
CONFIG_DEBUG_ALERT=y
CONFIG_DEBUG_FEATURES=y
CONFIG_ARCH_HAVE_STACKCHECK=y
CONFIG_STACK_COLORATION=y
CONFIG_DEBUG_SYMBOLS=y
CONFIG_ARCH_HAVE_CUSTOMOPT=y
CONFIG_DEBUG_NOOPT=y
CONFIG_ARCH_ARM=y
CONFIG_ARCH="arm"
CONFIG_ARCH_CHIP_STM32H7=y
CONFIG_ARCH_ARMV7M=y
CONFIG_ARCH_CORTEXM7=y
CONFIG_ARCH_FAMILY="armv7-m"
CONFIG_ARCH_CHIP="stm32h7"
CONFIG_ARM_HAVE_MPU_UNIFIED=y
CONFIG_ARM_MPU=y
CONFIG_ARM_MPU_NREGIONS=16
CONFIG_ARCH_HAVE_HARDFAULT_DEBUG=y
CONFIG_ARCH_HAVE_MEMFAULT_DEBUG=y
CONFIG_ARMV7M_HAVE_ICACHE=y
CONFIG_ARMV7M_HAVE_DCACHE=y
CONFIG_ARMV7M_USEBASEPRI=y
CONFIG_ARMV7M_ICACHE=y
CONFIG_ARMV7M_DCACHE=y
CONFIG_ARMV7M_DCACHE_WRITETHROUGH=y
CONFIG_ARMV7M_HAVE_ITCM=y
CONFIG_ARMV7M_HAVE_DTCM=y
CONFIG_ARMV7M_DTCM=y
CONFIG_ARMV7M_TOOLCHAIN_GNU_EABIL=y
CONFIG_ARCH_CHIP_STM32H743ZI=y
CONFIG_STM32H7_STM32H7X3XX=y
CONFIG_STM32H7_FLASH_CONFIG_I=y
CONFIG_STM32H7_FLASH_OVERRIDE_I=y
CONFIG_STM32H7_HAVE_SPI4=y
CONFIG_STM32H7_HAVE_SPI5=y
CONFIG_STM32H7_HAVE_SPI6=y
CONFIG_STM32H7_DMA=y
CONFIG_STM32H7_I2C=y
CONFIG_STM32H7_SPI=y
CONFIG_STM32H7_USART=y
CONFIG_STM32H7_DMA1=y
CONFIG_STM32H7_DMA2=y
CONFIG_STM32H7_I2C1=y
CONFIG_STM32H7_I2C2=y
CONFIG_STM32H7_I2C3=y
CONFIG_STM32H7_I2C4=y
CONFIG_STM32H7_SPI1=y
CONFIG_STM32H7_SPI2=y
CONFIG_STM32H7_SPI4=y
CONFIG_STM32H7_SPI5=y
CONFIG_STM32H7_SYSCFG=y
CONFIG_STM32H7_USART1=y
CONFIG_STM32H7_USART2=y
CONFIG_STM32H7_USART3=y
CONFIG_STM32H7_UART4=y
CONFIG_STM32H7_UART5=y
CONFIG_STM32H7_USART6=y
CONFIG_STM32H7_UART7=y
CONFIG_STM32H7_UART8=y
CONFIG_STM32H7_I2CTIMEOSEC=0
CONFIG_STM32H7_I2CTIMEOMS=500
CONFIG_STM32H7_I2CTIMEOTICKS=500
CONFIG_STM32H7_SPI_DMA=y
CONFIG_STM32H7_DMACAPABLE=y
CONFIG_USART1_RXFIFO_THRES=3
CONFIG_USART2_RXFIFO_THRES=3
CONFIG_USART3_RXFIFO_THRES=3
CONFIG_UART4_RXFIFO_THRES=3
CONFIG_UART5_RXFIFO_THRES=3
CONFIG_USART6_RXFIFO_THRES=3
CONFIG_UART7_RXFIFO_THRES=3
CONFIG_UART8_RXFIFO_THRES=3
CONFIG_STM32H7_SERIAL_DISABLE_REORDERING=y
CONFIG_STM32H7_USART_BREAKS=y
CONFIG_STM32H7_SERIALBRK_BSDCOMPAT=y
CONFIG_ARCH_TOOLCHAIN_GNU=y
CONFIG_ARCH_HAVE_IRQTRIGGER=y
CONFIG_ARCH_DMA=y
CONFIG_ARCH_HAVE_IRQPRIO=y
CONFIG_ARCH_ICACHE=y
CONFIG_ARCH_DCACHE=y
CONFIG_ARCH_HAVE_VFORK=y
CONFIG_ARCH_HAVE_FPU=y
CONFIG_ARCH_HAVE_DPFPU=y
CONFIG_ARCH_HAVE_LAZYFPU=y
CONFIG_ARCH_HAVE_MPU=y
CONFIG_ARCH_HAVE_RESET=y
CONFIG_ARCH_HAVE_TESTSET=y
CONFIG_ARCH_FPU=y
CONFIG_ARCH_DPFPU=y
CONFIG_ARCH_USE_MPU=y
CONFIG_ARCH_IRQPRIO=y
CONFIG_ARCH_STACKDUMP=y
CONFIG_ARCH_HAVE_RAMVECTORS=y
CONFIG_BOARD_LOOPSPERMSEC=43103
CONFIG_ARCH_HAVE_INTERRUPTSTACK=y
CONFIG_ARCH_INTERRUPTSTACK=750
CONFIG_ARCH_HAVE_HIPRI_INTERRUPT=y
CONFIG_ARCH_HIPRI_INTERRUPT=y
CONFIG_ARCH_INT_DISABLEALL=y
CONFIG_BOOT_RUNFROMFLASH=y
CONFIG_RAM_START=0x24000000
CONFIG_RAM_SIZE=524288
CONFIG_ARCH_BOARD_DELIBOZ=y
CONFIG_ARCH_BOARD="deliboz"
CONFIG_ARCH_HAVE_LEDS=y
CONFIG_ARCH_HAVE_BUTTONS=y
CONFIG_LIB_BOARDCTL=y
CONFIG_BOARDCTL_RESET=y
CONFIG_BOARD_RESET_ON_ASSERT=2
CONFIG_BOARD_ASSERT_RESET_VALUE=0
CONFIG_USEC_PER_TICK=1000
CONFIG_CLOCK_MONOTONIC=y
CONFIG_START_YEAR=2016
CONFIG_START_MONTH=11
CONFIG_START_DAY=30
CONFIG_MAX_WDOGPARMS=2
CONFIG_PREALLOC_WDOGS=50
CONFIG_WDOG_INTRESERVE=4
CONFIG_PREALLOC_TIMERS=50
CONFIG_INIT_ENTRYPOINT=y
CONFIG_USER_ENTRYPOINT="nsh_main"
CONFIG_USERMAIN_PRIORITY=100
CONFIG_RR_INTERVAL=0
CONFIG_TASK_NAME_SIZE=24
CONFIG_MAX_TASKS=64
CONFIG_SCHED_WAITPID=y
CONFIG_NPTHREAD_KEYS=4
CONFIG_PTHREAD_MUTEX_ROBUST=y
CONFIG_SCHED_SUSPENDSCHEDULER=y
CONFIG_SCHED_RESUMESCHEDULER=y
CONFIG_SCHED_INSTRUMENTATION=y
CONFIG_SCHED_INSTRUMENTATION_BUFFER=y
CONFIG_SCHED_NOTE_BUFSIZE=2048
CONFIG_DEV_CONSOLE=y
CONFIG_FDCLONE_STDIO=y
CONFIG_SDCLONE_DISABLE=y
CONFIG_NFILE_DESCRIPTORS=54
CONFIG_NFILE_STREAMS=8
CONFIG_NAME_MAX=32
CONFIG_PRIORITY_INHERITANCE=y
CONFIG_SEM_PREALLOCHOLDERS=32
CONFIG_SEM_NNESTPRIO=16
CONFIG_SCHED_ATEXIT=y
CONFIG_SCHED_ATEXIT_MAX=1
CONFIG_SIG_SIGUSR1=1
CONFIG_SIG_SIGUSR2=2
CONFIG_SIG_SIGALRM=3
CONFIG_SIG_SIGCONDTIMEDOUT=16
CONFIG_SIG_SIGWORK=4
CONFIG_PREALLOC_MQ_MSGS=4
CONFIG_MQ_MAXMSGSIZE=32
CONFIG_MODULE=y
CONFIG_SCHED_WORKQUEUE=y
CONFIG_SCHED_HPWORK=y
CONFIG_SCHED_HPNTHREADS=1
CONFIG_SCHED_HPWORKPRIORITY=249
CONFIG_SCHED_HPWORKSTACKSIZE=1800
CONFIG_SCHED_LPWORK=y
CONFIG_SCHED_LPNTHREADS=1
CONFIG_SCHED_LPWORKPRIORITY=50
CONFIG_SCHED_LPWORKPRIOMAX=176
CONFIG_SCHED_LPWORKSTACKSIZE=1800
CONFIG_IDLETHREAD_STACKSIZE=750
CONFIG_USERMAIN_STACKSIZE=2624
CONFIG_PTHREAD_STACK_MIN=512
CONFIG_PTHREAD_STACK_DEFAULT=2048
CONFIG_DEV_NULL=y
CONFIG_RAMDISK=y
CONFIG_I2C=y
CONFIG_ARCH_HAVE_SPI_BITORDER=y
CONFIG_SPI=y
CONFIG_SPI_SLAVE=y
CONFIG_SPI_EXCHANGE=y
CONFIG_RTC=y
CONFIG_RTC_DATETIME=y
CONFIG_WATCHDOG=y
CONFIG_WATCHDOG_DEVPATH="/dev/watchdog0"
CONFIG_PIPES=y
CONFIG_DEV_PIPE_MAXSIZE=1024
CONFIG_DEV_PIPE_SIZE=70
CONFIG_DEV_FIFO_SIZE=1024
CONFIG_SERIAL=y
CONFIG_SERIAL_CONSOLE=y
CONFIG_MCU_SERIAL=y
CONFIG_STANDARD_SERIAL=y
CONFIG_SERIAL_NPOLLWAITERS=2
CONFIG_SERIAL_OFLOWCONTROL=y
CONFIG_ARCH_HAVE_SERIAL_TERMIOS=y
CONFIG_SERIAL_TERMIOS=y
CONFIG_UART7_SERIAL_CONSOLE=y
CONFIG_UART4_SERIALDRIVER=y
CONFIG_UART5_SERIALDRIVER=y
CONFIG_UART7_SERIALDRIVER=y
CONFIG_UART8_SERIALDRIVER=y
CONFIG_UART4_RXBUFSIZE=300
CONFIG_UART4_TXBUFSIZE=600
CONFIG_UART4_BAUD=115200
CONFIG_UART4_BITS=8
CONFIG_UART4_PARITY=0
CONFIG_UART4_2STOP=0
CONFIG_UART5_RXBUFSIZE=300
CONFIG_UART5_TXBUFSIZE=600
CONFIG_UART5_BAUD=115200
CONFIG_UART5_BITS=8
CONFIG_UART5_PARITY=0
CONFIG_UART5_2STOP=0
CONFIG_UART7_RXBUFSIZE=300
CONFIG_UART7_TXBUFSIZE=600
CONFIG_UART7_BAUD=115200
CONFIG_UART7_BITS=8
CONFIG_UART7_PARITY=0
CONFIG_UART7_2STOP=0
CONFIG_UART8_RXBUFSIZE=600
CONFIG_UART8_TXBUFSIZE=1500
CONFIG_UART8_BAUD=115200
CONFIG_UART8_BITS=8
CONFIG_UART8_PARITY=0
CONFIG_UART8_2STOP=0
CONFIG_UART8_OFLOWCONTROL=y
CONFIG_USART1_SERIALDRIVER=y
CONFIG_USART2_SERIALDRIVER=y
CONFIG_USART3_SERIALDRIVER=y
CONFIG_USART6_SERIALDRIVER=y
CONFIG_USART1_RXBUFSIZE=300
CONFIG_USART1_TXBUFSIZE=600
CONFIG_USART1_BAUD=1000000
CONFIG_USART1_BITS=8
CONFIG_USART1_PARITY=0
CONFIG_USART1_2STOP=0
CONFIG_USART2_RXBUFSIZE=600
CONFIG_USART2_TXBUFSIZE=1500
CONFIG_USART2_BAUD=57600
CONFIG_USART2_BITS=8
CONFIG_USART2_PARITY=0
CONFIG_USART2_2STOP=0
CONFIG_USART3_RXBUFSIZE=600
CONFIG_USART3_TXBUFSIZE=1500
CONFIG_USART3_BAUD=115200
CONFIG_USART3_BITS=8
CONFIG_USART3_PARITY=0
CONFIG_USART3_2STOP=0
CONFIG_USART6_RXBUFSIZE=300
CONFIG_USART6_TXBUFSIZE=600
CONFIG_USART6_BAUD=115200
CONFIG_USART6_BITS=8
CONFIG_USART6_PARITY=0
CONFIG_USART6_2STOP=0
CONFIG_SYSLOG_WRITE=y
CONFIG_RAMLOG=y
CONFIG_RAMLOG_CONSOLE=y
CONFIG_RAMLOG_BUFSIZE=1024
CONFIG_RAMLOG_NONBLOCKING=y
CONFIG_RAMLOG_NPOLLWAITERS=4
CONFIG_SYSLOG_TIMESTAMP=y
CONFIG_SYSLOG_SERIAL_CONSOLE=y
CONFIG_SYSLOG_CONSOLE=y
CONFIG_ARCH_HAVE_NET=y
CONFIG_NET_READAHEAD=y
CONFIG_NET=y
CONFIG_NET_ETH_PKTSIZE=590
CONFIG_NET_GUARDSIZE=2
CONFIG_NET_ETHERNET=y
CONFIG_NETDEV_LATEINIT=y
CONFIG_NETDEV_IOCTL=y
CONFIG_NETDEV_PHY_IOCTL=y
CONFIG_NET_IPv4=y
CONFIG_NSOCKET_DESCRIPTORS=16
CONFIG_NET_NACTIVESOCKETS=16
CONFIG_NET_SOCKOPTS=y
CONFIG_NET_SOLINGER=y
CONFIG_NET_TCP=y
CONFIG_NET_TCP_CONNS=8
CONFIG_NET_MAX_LISTENPORTS=20
CONFIG_NET_TCP_READAHEAD=y
CONFIG_NET_TCP_RECVDELAY=0
CONFIG_NET_UDP=y
CONFIG_NET_UDP_CHECKSUMS=y
CONFIG_NET_UDP_CONNS=8
CONFIG_NET_BROADCAST=y
CONFIG_NET_UDP_READAHEAD=y
CONFIG_NET_ICMP=y
CONFIG_NET_ICMP_SOCKET=y
CONFIG_NET_ICMP_NCONNS=1
CONFIG_NET_ARP=y
CONFIG_NET_ARPTAB_SIZE=16
CONFIG_NET_ARP_MAXAGE=120
CONFIG_NET_ARP_IPIN=y
CONFIG_NET_ARP_SEND=y
CONFIG_ARP_SEND_MAXTRIES=5
CONFIG_ARP_SEND_DELAYMSEC=20
CONFIG_NET_STATISTICS=y
CONFIG_FS_READABLE=y
CONFIG_FS_WRITABLE=y
CONFIG_FS_MQUEUE_MPATH="/var/mqueue"
CONFIG_FS_FAT=y
CONFIG_FAT_LCNAMES=y
CONFIG_FAT_LFN=y
CONFIG_FAT_MAXFNAME=32
CONFIG_FAT_LFN_ALIAS_TRAILCHARS=0
CONFIG_FS_FATTIME=y
CONFIG_FAT_DIRECT_RETRY=y
CONFIG_FS_ROMFS=y
CONFIG_FS_BINFS=y
CONFIG_FS_PROCFS=y
CONFIG_FS_PROCFS_REGISTER=y
CONFIG_FS_PROCFS_EXCLUDE_ENVIRON=y
CONFIG_FS_PROCFS_EXCLUDE_VERSION=y
CONFIG_NXFONTS_PACKEDMSFIRST=y
CONFIG_MM_REGIONS=1
CONFIG_GRAN=y
CONFIG_GRAN_INTR=y
CONFIG_MM_IOB=y
CONFIG_IOB_NBUFFERS=36
CONFIG_IOB_BUFSIZE=196
CONFIG_IOB_NCHAINS=36
CONFIG_IOB_THROTTLE=0
CONFIG_BUILTIN=y
CONFIG_STDIO_BUFFER_SIZE=32
CONFIG_STDIO_LINEBUFFER=y
CONFIG_NUNGET_CHARS=2
CONFIG_LIBC_FLOATINGPOINT=y
CONFIG_LIBC_LONG_LONG=y
CONFIG_EOL_IS_EITHER_CRLF=y
CONFIG_ARCH_LOWPUTC=y
CONFIG_LIBC_ARCH_MEMCPY=y
CONFIG_LIBC_ARCH_ELF=y
CONFIG_ARMV7M_MEMCPY=y
CONFIG_LIB_RAND_ORDER=1
CONFIG_LIB_HOMEDIR="/"
CONFIG_LIBC_TMPDIR="/tmp"
CONFIG_LIBC_MAX_TMPFILE=32
CONFIG_POSIX_SPAWN_PROXY_STACKSIZE=1024
CONFIG_TASK_SPAWN_DEFAULT_STACKSIZE=2048
CONFIG_LIB_HOSTNAME=""
CONFIG_LIBC_STRERROR=y
CONFIG_MEMSET_OPTSPEED=y
CONFIG_MEMSET_64BIT=y
CONFIG_LIBC_DLFCN=y
CONFIG_LIBC_MODLIB=y
CONFIG_MODLIB_MAXDEPEND=2
CONFIG_MODLIB_ALIGN_LOG2=2
CONFIG_MODLIB_BUFFERSIZE=32
CONFIG_MODLIB_BUFFERINCR=32
CONFIG_MODLIB_RELOCATION_BUFFERCOUNT=256
CONFIG_MODLIB_SYMBOL_CACHECOUNT=256
CONFIG_TIME_EXTENDED=y
CONFIG_ARCH_HAVE_TLS=y
CONFIG_LIBC_NETDB=y
CONFIG_LIB_SENDFILE_BUFSIZE=512
CONFIG_LIB_HEX2BIN=y
CONFIG_C99_BOOL8=y
CONFIG_HAVE_CXX=y
CONFIG_BUILTIN_PROXY_STACKSIZE=1024
CONFIG_UROS_PINGPONG_EXAMPLE=y
CONFIG_FSUTILS_MKFATFS=y
CONFIG_NETUTILS_NETLIB=y
CONFIG_NETUTILS_PING=y
CONFIG_NSH_LIBRARY=y
CONFIG_NSH_MOTD=y
CONFIG_NSH_PROMPT_STRING="delibozv2>"
CONFIG_NSH_MOTD_STRING="Welcome to Deliboz FW"
CONFIG_NSH_NETINIT=y
CONFIG_NSH_READLINE=y
CONFIG_NSH_LINELEN=128
CONFIG_NSH_QUOTE=y
CONFIG_NSH_CMDPARMS=y
CONFIG_NSH_MAXARGUMENTS=12
CONFIG_NSH_ARGCAT=y
CONFIG_NSH_NESTDEPTH=8
CONFIG_NSH_BUILTIN_APPS=y
CONFIG_NSH_DISABLE_LOSMART=y
CONFIG_NSH_DISABLE_PSSTACKUSAGE=y
CONFIG_NSH_DISABLE_REBOOT=y
CONFIG_NSH_DISABLE_SHUTDOWN=y
CONFIG_NSH_DISABLE_TRUNCATE=y
CONFIG_NSH_MMCSDMINOR=0
CONFIG_NSH_CODECS_BUFSIZE=128
CONFIG_NSH_PROC_MOUNTPOINT="/proc"
CONFIG_NSH_FILEIOSIZE=512
CONFIG_NSH_STRERROR=y
CONFIG_NSH_ROMFSETC=y
CONFIG_NSH_ROMFSMOUNTPT="/etc"
CONFIG_NSH_INITSCRIPT="init.d/rcS"
CONFIG_NSH_ROMFSDEVNO=0
CONFIG_NSH_ROMFSSECTSIZE=64
CONFIG_NSH_ARCHROMFS=y
CONFIG_NSH_FATDEVNO=1
CONFIG_NSH_FATSECTSIZE=512
CONFIG_NSH_FATNSECTORS=1024
CONFIG_NSH_FATMOUNTPT="/tmp"
CONFIG_NSH_CONSOLE=y
CONFIG_NSH_ARCHINIT=y
CONFIG_HAVE_CXXINITIALIZE=y
CONFIG_SYSTEM_HEX2BIN=y
CONFIG_SYSTEM_NETDB=y
CONFIG_SYSTEM_NETDB_STACKSIZE=2048
CONFIG_SYSTEM_NETDB_PRIORITY=100
CONFIG_SYSTEM_NSH=y
CONFIG_SYSTEM_NSH_PRIORITY=100
CONFIG_SYSTEM_NSH_STACKSIZE=2048
CONFIG_SYSTEM_NSH_CXXINITIALIZE=y
CONFIG_SYSTEM_PING=y
CONFIG_SYSTEM_PING_PRIORITY=100
CONFIG_SYSTEM_PING_STACKSIZE=2048
CONFIG_READLINE_HAVE_EXTMATCH=y
CONFIG_SYSTEM_READLINE=y
CONFIG_READLINE_ECHO=y
CONFIG_UROS=y
CONFIG_UROS_DIR="../mcu_ws/"
CONFIG_UROS_TRANSPORT_SERIAL=y
CONFIG_UROS_SERIAL_PORT="/dev/ttyS2"
CONFIG_UROS_MAX_NODES=2
CONFIG_UROS_MAX_PUBLISHERS=2
CONFIG_UROS_MAX_SUBSCRIPTIONS=2
CONFIG_UROS_MAX_SERVICES=1
CONFIG_UROS_MAX_CLIENTS=1
CONFIG_UROS_MAX_HISTORY=2
CONFIG_UROS_XML_BUFFER_LENGTH=400
CONFIG_STM32H7_RTC=y
CONFIG_STM32H7_RTC_HSECLOCK=y
CONFIG_STM32H7_PWR=y
CONFIG_DVFS=y
CONFIG_NSH_CROMFSETC=y
CONFIG_NSH_HAVE_WRITABLE_MOUNTPOINT=y
```
